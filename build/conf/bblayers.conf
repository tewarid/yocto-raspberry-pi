## build/conf/bblayers.conf
```bitbake
# POKY_BBLAYERS_CONF_VERSION is increased each time build/conf/bblayers.conf
# changes incompatibly
POKY_BBLAYERS_CONF_VERSION = "2"

BBPATH = "${TOPDIR}"
BBFILES ?= ""

BBLAYERS ?= " \
  /home/pi/yocto-raspberry-pi/layers/poky/meta \
  /home/pi/yocto-raspberry-pi/layers/poky/meta-poky \
  /home/pi/yocto-raspberry-pi/layers/poky/meta-yocto-bsp \
  /home/pi/yocto-raspberry-pi/layers/meta-raspberrypi \
  "
```

## layers/meta-berry/conf/layer.conf
```bitbake
# We have a conf and classes directory, append to BBPATH
BBPATH .= ":${LAYERDIR}"

# We have a recipes directory, add to BBFILES
BBFILES += "${LAYERDIR}/recipes-*/*/*.bb ${LAYERDIR}/recipes-*/*/*.bbappend"

BBFILE_COLLECTIONS += "berry-layer"
BBFILE_PATTERN_berry-layer := "^${LAYERDIR}/"
BBFILE_PRIORITY_berry-layer = "7"

LAYERVERSION_berry-layer = "1"
LAYERSERIES_COMPAT_berry-layer = "dunfell gatesgarth hardknott"

LAYERDEPENDS_berry-layer = "core"
```

## layers/meta-matter/conf/layer.conf
```bitbake
# We have a conf and classes directory, append to BBPATH
BBPATH .= ":${LAYERDIR}"

# We have a recipes directory, add to BBFILES
BBFILES += "${LAYERDIR}/recipes-*/*/*.bb ${LAYERDIR}/recipes-*/*/*.bbappend"

BBFILE_COLLECTIONS += "matter-layer"
BBFILE_PATTERN_matter-layer := "^${LAYERDIR}/"
BBFILE_PRIORITY_matter-layer = "7"

LAYERVERSION_matter-layer = "1"
LAYERSERIES_COMPAT_matter-layer = "dunfell gatesgarth hardknott"

LAYERDEPENDS_matter-layer = "clang-layer core openembedded-layer"
```

## layers/meta-voicecard/conf/layer.conf
```bitbake
# We have a conf and classes directory, add to BBPATH
BBPATH .= ":${LAYERDIR}"

# We have recipes-* directories, add to BBFILES
BBFILES += "${LAYERDIR}/recipes-*/*/*.bb \
            ${LAYERDIR}/recipes-*/*/*.bbappend"

BBFILE_COLLECTIONS += "meta-voicecard"
BBFILE_PATTERN_meta-voicecard = "^${LAYERDIR}/"
BBFILE_PRIORITY_meta-voicecard = "6"

LAYERDEPENDS_meta-voicecard = "core"
LAYERSERIES_COMPAT_meta-voicecard = "hardknott"
```
